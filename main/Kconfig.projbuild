## main/Kconfig.projbuild
```kconfig
menu "StoryBox migration"
    config STORYBOX_APP_UI
        bool "Run the product UI (home, settings, media pages)"
        default y
        help
            Starts the native app task instead of the diagnostic loop.
            Diagnostics take precedence when STORYBOX_PERIPHERAL_DIAGNOSTICS is
            enabled, because those fragments are hardware acceptance builds.
            Pages beyond home/settings are still being migrated; see
            docs/idf-migration-progress.md.
    config STORYBOX_POWER_SLEEP
        bool "Enable deep sleep after the idle window"
        default n
        help
            Sleeps the device after the configured idle minutes when nothing is
            playing. Wake-up uses EXT1 on the encoder pins (GPIO14/15/21), so
            only enable it after confirming those pins are wired on the target
            board; otherwise the device can only be revived by reflashing.
            Screen-off still works with this option disabled.
    config STORYBOX_NFC
        bool "Enable PN532 NFC on the shared I2C bus"
        default y
        help
            Starts the native NFC polling task and advertises the "nfc" feature
            on the USB protocol. Status only: raw card reads and writes are not
            exposed yet. A missing or unresponsive PN532 degrades to
            NFC_UNAVAILABLE instead of failing startup.
    config STORYBOX_USB_FILE_WRITES
        bool "Enable diagnostic USB file uploads (not full desktop FS support)"
        depends on STORYBOX_USB_PROTOCOL && STORYBOX_AUDIO_DIAGNOSTICS
        default n
        help
            Enables explicit host-requested uploads in existing directories.
            Requires stopped playback and an exclusive storage session.
            Authentication and automatic media refresh are not yet implemented.
    config STORYBOX_NFC_DIAGNOSTICS
        bool "Enable PN532 diagnostic polling on shared I2C"
        depends on STORYBOX_PERIPHERAL_DIAGNOSTICS
        default n
    config STORYBOX_USB_PROTOCOL
        bool "Enable native USB v4 diagnostic protocol"
        depends on ESP_CONSOLE_NONE
        default n
        help
            Disable the IDF console to give the protocol TX task sole ownership
            of USB output. ESP_LOG output is queued by the same TX task.
            Audio diagnostics publish read-only file commands after SD mount.
            File sessions require all playback/image handles to be released.
    config STORYBOX_FRAM_CONFIRMED
        bool "Physical FRAM model and selected board profile have been confirmed"
        default y
        help
            Enables real FRAM access. The legacy board carries an MB85RC16 whose
            11-bit address aliases across 0x50..0x57; the 2026-10-28 board uses
            an FM24CL64B at 0x51. FramDevice additionally probes every bank with
            a write/read scratch test at boot, so a mismatched or absent chip
            degrades to RAM-only settings instead of persisting corrupt records.
    config STORYBOX_NETWORK_DIAGNOSTICS
        bool "Enable Wi-Fi mode controls in diagnostics (starts with radio off)"
        depends on STORYBOX_PERIPHERAL_DIAGNOSTICS
        default n
    config STORYBOX_PERIPHERAL_DIAGNOSTICS
        bool "Run display, input and SD diagnostics (confirm board wiring first)"
        default n
    config STORYBOX_AUDIO_DIAGNOSTICS
        bool "Enable MP3 playback controls in diagnostics"
        depends on STORYBOX_PERIPHERAL_DIAGNOSTICS
        default n
        help
            Loads the configured MP3 paused. OK toggles playback; encoder changes
            volume. Confirm amplifier wiring before enabling. No GPIO38 enable
            is asserted until its board-specific polarity is verified.
    config STORYBOX_AUDIO_TEST_PATH
        string "SD MP3 test path"
        depends on STORYBOX_AUDIO_DIAGNOSTICS
        default "/music/test.mp3"
    choice STORYBOX_BOARD
        prompt "Board profile (confirm against physical hardware)"
        default STORYBOX_BOARD_LEGACY
        config STORYBOX_BOARD_LEGACY
            bool "Legacy board (FRAM model unverified)"
        config STORYBOX_BOARD_REV_20261028
            bool "2026-10-28 schematic (assembly unverified)"
    endchoice
endmenu
```
